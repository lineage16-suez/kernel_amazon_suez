## arch/arm64/configs/suez_debug_defconfig
```kconfig
CONFIG_MAGIC_SYSRQ=y
CONFIG_MAGIC_SYSRQ_WD_TEST=y
CONFIG_IKCONFIG=y
CONFIG_IKCONFIG_PROC=y
CONFIG_LOG_BUF_SHIFT=20
CONFIG_PERF_EVENTS=y
CONFIG_PM_DEBUG=y
CONFIG_PM_ADVANCED_DEBUG=y
CONFIG_CFG80211_DEBUGFS=y
CONFIG_MTK_MEMCFG=y
CONFIG_MT_ENG_BUILD=y
CONFIG_MDUMP=y
CONFIG_MDUMP_COMPRESS=y
CONFIG_DM_DEBUG=y
CONFIG_INPUT_KEYPANIC=y
CONFIG_MTK_KEYRESET=y
CONFIG_DEVMEM=y
CONFIG_SND_SOC_RT5514_TEST_ONLY=y
CONFIG_EXT4_DEBUG=y
CONFIG_DYNAMIC_DEBUG=y
CONFIG_CRASH_NOTES=y
CONFIG_ARCH_HAS_CRASH_NOTES=y
CONFIG_SLUB_DEBUG_ON=y
CONFIG_SLUB_DEBUG=y
CONFIG_DEBUG_KMEMLEAK=y
CONFIG_DEBUG_KMEMLEAK_EARLY_LOG_SIZE=800
CONFIG_DEBUG_KMEMLEAK_DEFAULT_OFF=y
CONFIG_DETECT_HUNG_TASK=y
CONFIG_PANIC_TIMEOUT=5
CONFIG_TIMER_STATS=y
CONFIG_DEBUG_LOCKDEP=y
CONFIG_DEBUG_ATOMIC_SLEEP=y
CONFIG_DEBUG_LIST=y
CONFIG_RCU_TRACE=y
CONFIG_MTK_SCHED_TRACERS=y
CONFIG_MTK_FTRACE_DEFAULT_ENABLE=y
CONFIG_TRACER_SNAPSHOT=y
CONFIG_TRACER_MAX_TRACE=y
CONFIG_DMA_API_DEBUG=y
CONFIG_KGDB=y
CONFIG_KGDB_KDB=y
CONFIG_PROFILING=y
CONFIG_AMAZON_LOGD=y
CONFIG_SECURITY_SELINUX_KERN_PERMISSIVE=y
```
